## boards/hpmicro/hpm6e00evk_v2/Kconfig
```kconfig
# Copyright (c) 2025 HPMicro
# SPDX-License-Identifier: BSD-3-Clause

if BOARD_HPM6E00EVK_V2

config INIT_EXT_RAM
    bool "Initialize external RAM(SDRAM or DDR)"
    default y
    select HAS_HPMSDK_FEMC

config HPMICRO_BOARD_SUPPORT_EMMC
    bool "SUPPORT EMMC"
    default n
    help
      SUPPORT EMMC

endif # BOARD_HPM6E00EVK_V2
```

## boards/hpmicro/hpm6e00evk_v2/Kconfig.defconfig
```kconfig
# Copyright (c) 2025 HPMicro
# SPDX-License-Identifier: Apache-2.0

if BOARD_HPM6E00EVK_V2

config HEAP_MEM_POOL_SIZE
	default 16384

config BUILD_OUTPUT_HEX
	default y

config UART_INTERRUPT_DRIVEN
	default y

endif
```

## boards/hpmicro/hpm6e00evk_v2/Kconfig.hpm6e00evk_v2
```kconfig
# Copyright (c) 2025 HPMicro
# SPDX-License-Identifier: Apache-2.0

config BOARD_HPM6E00EVK_V2
	select SOC_HPM6E80
```

## boards/hpmicro/hpm6e00evk_v2/hpm6e00evk_v2_defconfig
```kconfig
CONFIG_CONSOLE=y
CONFIG_UART_CONSOLE=y
CONFIG_XIP=y
CONFIG_PINCTRL=y
CONFIG_GPIO=y
CONFIG_SERIAL=y
CONFIG_NOCACHE_MEMORY=y
CONFIG_FLASH=y
```
