## boards/hpmicro/hpm6200evk/Kconfig
```kconfig
# Copyright (c) 2025 HPMicro
# SPDX-License-Identifier: BSD-3-Clause

if BOARD_HPM6200EVK

config INIT_EXT_RAM
    bool "Initialize external RAM(SDRAM or DDR)"
    default n
    select HAS_HPMSDK_FEMC

config HPMICRO_BOARD_SUPPORT_EMMC
    bool "SUPPORT EMMC"
    default n
    help
      SUPPORT EMMC

endif #BOARD_HPM6200EVK
```

## cmake/toolchain/zcc/Kconfig
```kconfig
# Copyright (c) 2025 HPMicro
# SPDX-License-Identifier: Apache-2.0

config TOOLCHAIN_ZZC_SUPPORTS_THREAD_LOCAL_STORAGE
	depends on RISCV
	def_bool y
	select TOOLCHAIN_SUPPORTS_THREAD_LOCAL_STORAGE

config STATIC_INIT_GNU
    default y

config BUILD_NO_GAP_FILL
    default y
```

## drivers/pwm/Kconfig.hpmicro
```kconfig
# Copyright (c) 2024 HPMicro
# SPDX-License-Identifier: Apache-2.0
DT_COMPAT_HPM_PWM := hpmicro,hpm-pwm
DT_COMPAT_HPM_PWMV2 := hpmicro,hpm-pwmv2

config PWM_HPMICRO
	bool "HPMicro PWM driver"
	default y
	depends on DT_HAS_HPMICRO_HPM_PWM_ENABLED || DT_HAS_HPMICRO_HPM_PWMV2_ENABLED
	select HAS_HPMSDK_PWM if DT_HAS_HPMICRO_HPM_PWM_ENABLED
	select HAS_HPMSDK_PWMV2 if DT_HAS_HPMICRO_HPM_PWMV2_ENABLED
	help
	  Enable hpmicro pwm driver. Supports both PWM and PWMv2 peripherals.
```

## drivers/serial/Kconfig.hpmicro
```kconfig
# Copyright (c) 2024 HPMicro
# SPDX-License-Identifier: Apache-2.0
DT_COMPAT_HPM_UART := hpmicro,hpm-uart

config UART_HPMICRO
	bool "HPMICRO serial driver"
	default y
	depends on DT_HAS_HPMICRO_HPM_UART_ENABLED
	select HAS_HPMSDK_UART
	select SERIAL_HAS_DRIVER
	select SERIAL_SUPPORT_INTERRUPT
	select SERIAL_SUPPORT_ASYNC
	select HAS_HPMSDK_GPTMR if SERIAL_SUPPORT_ASYNC
	select HAS_HPMSDK_DMA if (SERIAL_SUPPORT_ASYNC && DMA_HPMICRO)
	select HAS_HPMSDK_DMAV2 if (SERIAL_SUPPORT_ASYNC && DMAV2_HPMICRO)	
	select DMA if SERIAL_SUPPORT_ASYNC
	help
	  This option enables the UART driver for HPM SoC family.

config HPMICRO_UART_DIAG
	bool "Enable HPMicro UART async diagnostic counters"
	default n
	depends on UART_HPMICRO && UART_ASYNC_API
	help
	  Enable low-rate diagnostic counter output for the HPMicro UART async
	  receive path. This is intended for isolated UART tests only.
```

## drivers/spi/Kconfig.hpmicro
```kconfig
# Copyright (c) 2024 HPMicro
# SPDX-License-Identifier: Apache-2.0
DT_COMPAT_HPM_SPI := hpmicro,hpm-spi

config SPI_HPMICRO
	bool "HPMicro SPI driver"
	default y
	depends on DT_HAS_HPMICRO_HPM_SPI_ENABLED
	select HAS_HPMSDK_SPI
	select SPI
	help
	  Enable support for hpmicro spi driver.

if SPI_HPMICRO
config SPI_HPM_SPI_INTERRUPT
	bool "HPM SPI interrupt-driven transfers"
	depends on !SPI_HPM_SPI_DMA
	help
	  Use FIFO and transfer-complete interrupts for non-DMA SPI transfers.
	  The default polling path is reliable for short transfers and does not
	  turn SPI into software/bit-banged GPIO; the SPI peripheral still clocks
	  the bus. Enable this experimental path only after validating it with the
	  required transaction lengths.

config SPI_HPM_SPI_DMA
	bool "HPM SPI DMA Support"
	select DMA
	help
	  Enable the SPI DMA mode for SPI instances
	  that enable dma channels in their device tree node.
endif # SPI_HPM
```

## dts/bindings/flash/hpmicro,hpm-xpi.yaml
```yaml
# Copyright 2022 HPMicro
# SPDX-License-Identifier: Apache-2.0

description: HPMicro HPM FLASH

compatible: "hpmicro,xpi"

include: base.yaml

properties:

    reg:
      required: true
```

## dts/bindings/mtd/hpmicro,hpmicro-flash.yaml
```yaml
description: HPMICRO XPI ROM Api

compatible: "hpmicro,hpmicro-flash"

properties:
  "nor-cfg-opt-hdr":
    type: int
    required: true

  "nor-cfg-opt-opt0":
    type: int
    required: true

  "nor-cfg-opt-opt1":
    type: int
    required: true

include: [soc-nv-flash.yaml]
```

## dts/bindings/pwm/hpmicro,hpm-pwmv2.yaml
```yaml
# Copyright 2024 HPMicro
# SPDX-License-Identifier: Apache-2.0

description: HPMICRO PWMv2 Module

compatible: "hpmicro,hpm-pwmv2"

include: [pwm-controller.yaml, base.yaml, pinctrl-device.yaml]

properties:
    reg:
      required: true
    
    clocks:
      required: true

    pinctrl-0:
      required: false

    period-init:
      type: int
      description: pwm period, unit hz
      required: false
    
    dead-zone-in-half-cycle:
      type: int
      description: pwm dead zone in half cycle, unit cycle
      required: false

    en-pwm-trig:
      type: boolean
      description: Enable PWM trigger mode
      required: false

    "#pwm-cells":
      const: 3

pwm-cells:
  - channel
  - period
  - flags
```

## soc/hpmicro/HPM6200/Kconfig.soc
```kconfig
# Copyright (c) 2025 HPMicro
# SPDX-License-Identifier: Apache-2.0
config SOC_SERIES_HPM6200
	bool
	select SOC_FAMILY_HPM
	select HAS_HPMSDK_PLLCTLV2
	select HAS_HPMSDK_PCFG
	help
	  Enable support for HPMicro HPM62 series SoC

config SOC_SERIES
	default "HPM6200" if SOC_SERIES_HPM6200

config SOC_HPM6280
	bool
	select SOC_SERIES_HPM6200

config SOC
	default "HPM6280" if SOC_HPM6280
```

## soc/hpmicro/HPM6E00/Kconfig.soc
```kconfig
# Copyright (c) 2025 HPMicro
# SPDX-License-Identifier: Apache-2.0
config SOC_SERIES_HPM6E00
	bool
	select SOC_FAMILY_HPM
	select HAS_HPMSDK_PLLCTL
	select HAS_HPMSDK_PCFG
	help
	  Enable support for HPMicro HPM6E series SoC

config SOC_SERIES
	default "HPM6E00" if SOC_SERIES_HPM6E00

config SOC_HPM6E80
	bool
	select SOC_SERIES_HPM6E00

config SOC
	default "HPM6E80" if SOC_HPM6E80
```
